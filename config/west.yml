## config/west.yml
```yaml
manifest:
  remotes:
    - name: zmkfirmware
      url-base: https://github.com/zmkfirmware
    - name: inorichi
      url-base: https://github.com/inorichi
    - name: keyfreaks
      url-base: https://github.com/kay-yokoyama
    - name: caksoylar
      url-base: https://github.com/caksoylar
    - name: kot149
      url-base: https://github.com/kot149
  projects:
    - name: zmk
      remote: zmkfirmware
      revision: v0.2.1
      import: app/west.yml
    - name: zmk-pmw3610-driver
      remote: inorichi
      revision: main
    - name: zmk-mouse-gesture
      remote: kot149
      revision: v1
    - name: zmk-rgbled-widget
      remote: caksoylar
      revision: v0.3-branch
  self:
    path: config
```
